## base_external/Config.in
```kconfig
#from hello word example
#source "$BR2_EXTERNAL_project_base_PATH/package/ecen5013-hello-world/Config.in"
source "$BR2_EXTERNAL_project_base_PATH/package/aesd-assignments/Config.in"
```
